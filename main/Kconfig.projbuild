## main/Kconfig.projbuild
```kconfig
menu "tiny386 on M5Stack Tab5"

    choice TAB5_ROTATION
        prompt "Screen orientation"
        default TAB5_ROTATION_270
        help
            The 720x1280 portrait panel is used in landscape. Pick the
            orientation that is upright with the Tab5 Keyboard attached; if the
            picture is upside down, switch to the other one.

        config TAB5_ROTATION_90
            bool "Landscape, rotated 90 degrees"
        config TAB5_ROTATION_270
            bool "Landscape, rotated 270 degrees"
    endchoice

    choice TAB5_SCALE
        prompt "Scaling of the guest's picture"
        default TAB5_SCALE_SHARP
        help
            Guest modes smaller than the 1280x720 panel are scaled up to its
            height (4:3 for VGA modes).

        config TAB5_SCALE_SHARP
            bool "Sharp: even pixels, blended edges"
            help
                Every guest pixel gets the same size; only the panel pixels
                that fall across two guest pixels are blended. Crisp, even
                text. Costs some CPU time on the display core.
        config TAB5_SCALE_NEAREST
            bool "Nearest neighbour"
            help
                No blending, so the cheapest, but at these ratios some guest
                pixels come out twice as wide as others: uneven text.
        config TAB5_SCALE_OFF
            bool "Off: 1:1, centred"
    endchoice

    config TAB5_POWEROFF_ON_SHUTDOWN
        bool "Switch the Tab5 off when the guest shuts down"
        default y
        help
            When the guest turns the PC off through APM (Windows 9x "Shut
            down" with APM support installed, or a DOS power-off tool):
            speaker, panel and backlight off, USB-A 5V, EXT5V and the
            ESP32-C6 off, and the ESP32-P4 into deep sleep with no wake-up
            source. The reset button then powers it back on. The charger
            stays enabled.

    config TAB5_BACKLIGHT_PERCENT
        int "Backlight brightness (%)"
        range 5 100
        default 60

    config TAB5_PSRAM_POOL_MB
        int "PSRAM pool for the emulator (MB)"
        range 8 28
        default 24
        help
            Guest RAM (mem_size in tiny386.ini), VGA RAM and the 1280x720
            console frame buffer are carved out of this pool.

    config TAB5_HDD_CACHE_MB
        int "Disk image read cache in PSRAM (MB, 0 = off)"
        range 0 8
        default 2
        help
            Disk images on the SD card are read and written with raw sector
            DMA. This much PSRAM (outside the emulator pool) caches what the
            guest reads, in blocks that also act as read-ahead. Writes always
            go straight through to the card.

    config TAB5_HDD_CACHE_BLOCK_KB
        int "Disk cache block size (KB)"
        range 4 64
        default 16
        help
            Unit of the cache and of read-ahead: a miss reads this much from
            the card.

    config TAB5_TOUCHPAD
        bool "Touch screen as a touchpad (PS/2 mouse)"
        default y
        help
            The picture area works as a touchpad: slide to move the pointer,
            tap for a left click, two-finger tap for a right click. The black
            bars beside a 4:3 picture are the mouse buttons: left bar = left
            button, right bar = right button, held while touched. Needs no
            driver in the guest. GT911 (ILI9881C panel) or ST7123/ST7121
            panel touch.

    config TAB5_TOUCHPAD_SPEED
        int "Touchpad speed (%)"
        depends on TAB5_TOUCHPAD
        range 25 400
        default 100
        help
            Mouse movement per panel pixel the finger moves, in percent.
            Windows' own pointer speed applies on top.

    config TAB5_KBD_ENABLE
        bool "M5Stack Tab5 Keyboard (I2C)"
        default y

    config TAB5_KBD_I2C_PORT
        int "Tab5 Keyboard I2C port"
        depends on TAB5_KBD_ENABLE
        range 0 1
        default 0
        help
            Port 1 is the Tab5's internal SYS bus, so the keyboard uses port 0.

    config TAB5_KBD_SDA_GPIO
        int "Tab5 Keyboard SDA GPIO"
        depends on TAB5_KBD_ENABLE
        default 0

    config TAB5_KBD_SCL_GPIO
        int "Tab5 Keyboard SCL GPIO"
        depends on TAB5_KBD_ENABLE
        default 1

    config TAB5_KBD_I2C_ADDR
        hex "Tab5 Keyboard I2C address"
        depends on TAB5_KBD_ENABLE
        default 0x6D

    config TAB5_USB_HOST
        bool "USB host on the USB-A port (mouse, keyboard)"
        default y

endmenu
```
